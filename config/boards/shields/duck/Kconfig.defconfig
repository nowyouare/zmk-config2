## config/boards/shields/duck/Kconfig.defconfig
```kconfig
# Copyright (c) 2020 The ZMK Contributors
# SPDX-License-Identifier: MIT
#
# Author: Jack Hartstein
# Last Edited: December 20 2020

if SHIELD_DUCK

config ZMK_KEYBOARD_NAME
	default "duck"

endif
```

## config/boards/shields/duck/Kconfig.shield
```kconfig
# Copyright (c) 2020 The ZMK Contributors
# SPDX-License-Identifier: MIT
#
# Author: Jack Hartstein
# Last Edited: December 20 2020

config SHIELD_DUCK
	def_bool $(shields_list_contains, duck)
```
